## config/west.yml
```yaml
manifest:
  remotes:
    - name: zmkfirmware
      url-base: https://github.com/zmkfirmware
    - name: urob
      url-base: https://github.com/urob
    - name: carrefinho
      url-base: https://github.com/carrefinho
    - name: caksoylar
      url-base: https://github.com/caksoylar
  projects:
    # ZMK pinned to urob's tested commit (main, 4/19/2026, Zephyr 4.1).
    - name: zmk
      remote: zmkfirmware
      revision: 0331b7d16e80954b807917f9323e59ffc1e3b626
      import: app/west.yml

    # urob's behavior modules, pinned to the revisions he ships in his config.
    - name: zmk-adaptive-key
      remote: urob
      revision: 18cc2795a64ccb394d1a7b7d591a5bfe3f25924b
    - name: zmk-auto-layer
      remote: urob
      revision: dfa7c695ffde41ef8064245453595d50e198ae1d
    - name: zmk-helpers
      remote: urob
      revision: 0b9e9d1dd9e86f70b4c8c2b0fab55c4f90c9d2e3
    - name: zmk-leader-key
      remote: urob
      revision: 749f7faf65cc4105c82fbe64cfaa7e09a8a63605
    - name: zmk-tri-state
      remote: urob
      revision: 2007896c6d5bfb519e8babccf8633841c5647d8b

    # Forager hardware shield + RGB LED status widget.
    - name: forager-zmk-module
      remote: carrefinho
      revision: main
    - name: zmk-rgbled-widget
      remote: caksoylar
      revision: main
  self:
    path: config
```
